## drivers/rekernel_x/Kconfig
```kconfig
# SPDX-License-Identifier: GPL-2.0
#
# ReKernel-X LKM configuration
#

config REKERNEL_X
	tristate "ReKernel-X kernel module"
	depends on ANDROID_VENDOR_HOOKS
	depends on NETFILTER
	help
	  ReKernel-X Loadable Kernel Module for Android GKI kernels.
	  Provides binder transaction monitoring, signal hooking,
	  netfilter-based network traffic monitoring, and frozen
	  task detection.

	  Say M to build as a module, Y to build it into the kernel.
```
